## config/boards/shields/klor/Kconfig.defconfig
```kconfig
# Copyright (c) 2022 The ZMK Contributors
# SPDX-License-Identifier: MIT

config ZMK_SPLIT
    default y

config ZMK_BLE
    default y

if  SHIELD_KLOR_DONGLE_SNAKE 

config ZMK_KEYBOARD_NAME
    default "KLOR"

config ZMK_SPLIT_ROLE_CENTRAL
    default y

config ZMK_USB
    default y

# Set this to the number of peripherals your dongle will have.
# For a unibody, this would be 1. If you have left and right halves, set it to 2, etc.
config ZMK_SPLIT_BLE_CENTRAL_PERIPHERALS
    default 2

endif

if SHIELD_KLOR_LEFT || SHIELD_KLOR_RIGHT

config ZMK_SPLIT_ROLE_CENTRAL
    default n

if LVGL

    config LV_Z_VDB_SIZE
        default 64

    config LV_DPI_DEF
        default 148

    config LV_Z_BITS_PER_PIXEL
        default 1

    choice LV_COLOR_DEPTH
        default LV_COLOR_DEPTH_1
    endchoice

endif # LVGL


endif
```

## config/boards/shields/klor/Kconfig.shield
```kconfig
config SHIELD_KLOR_LEFT
    def_bool $(shields_list_contains,klor_left)

config SHIELD_KLOR_RIGHT
    def_bool $(shields_list_contains,klor_right)

config SHIELD_TOTEM_DONGLE_SNAKE
	def_bool $(shields_list_contains,klor_dongle_snake)
```
